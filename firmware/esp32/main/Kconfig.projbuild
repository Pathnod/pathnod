## firmware/esp32/main/Kconfig.projbuild
```kconfig
menu "Pathnod"
config PATHNOD_REQUIRE_ENCRYPTED_STORAGE
    bool "Require flash and NVS encryption before creating/loading identity"
    default n
    help
        Protected profile only. Enabling flash encryption can irreversibly
        program eFuses on first boot. Never flash this profile without review.

config PATHNOD_HELIUM_EMULATION
    bool "Demo only: Helium emulation (cNFT asset ID in INFO.protocol_hint)"
    default n
    help
        Spec 2.6 demo mode. INFO.protocol_hint carries the cNFT asset ID below
        and capability bit 5 is set. This does not make the board a Helium
        hotspot and proves no control of the asset (see register_device).

config PATHNOD_HELIUM_ASSET_ID
    string "Helium cNFT asset ID (base58, 32 bytes)"
    depends on PATHNOD_HELIUM_EMULATION
    default ""
    help
        The firmware refuses to start if this is empty, not canonical base58,
        not exactly 32 bytes or all zero.
endmenu
```

## firmware/esp32/sdkconfig.defaults
```kconfig
CONFIG_BT_ENABLED=y
CONFIG_BT_NIMBLE_ENABLED=y
CONFIG_BT_NIMBLE_ROLE_CENTRAL=n
CONFIG_BT_NIMBLE_ROLE_OBSERVER=n
CONFIG_BT_NIMBLE_MAX_CONNECTIONS=1
CONFIG_BT_NIMBLE_ATT_PREFERRED_MTU=185
CONFIG_PARTITION_TABLE_CUSTOM=y
CONFIG_PARTITION_TABLE_CUSTOM_FILENAME="partitions.csv"
CONFIG_ESPTOOLPY_FLASHSIZE_4MB=y
CONFIG_PATHNOD_REQUIRE_ENCRYPTED_STORAGE=n
CONFIG_NVS_ENCRYPTION=n
CONFIG_SECURE_FLASH_ENC_ENABLED=n
CONFIG_COMPILER_OPTIMIZATION_SIZE=y
CONFIG_LIBC_NEWLIB_NANO_FORMAT=y
```
